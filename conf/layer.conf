## conf/layer.conf
```bitbake
# We have a conf and classes directory, add to BBPATH
BBPATH .= ":${LAYERDIR}"

# We have recipes-* directories, add to BBFILES
BBFILES += "${LAYERDIR}/recipes-*/*/*.bb ${LAYERDIR}/recipes-*/*/*.bbappend"

BBFILE_COLLECTIONS += "fxland"
BBFILE_PATTERN_fxland = "^${LAYERDIR}/"
BBFILE_PRIORITY_fxland = "99"

# This should only be incremented on significant changes that will
# cause compatibility issues with other layers
LAYERVERSION_fxland = "1"

LAYERDEPENDS_fxland = "core"

LAYERSERIES_COMPAT_fxland = "kirkstone"
```
